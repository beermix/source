## toolchain/binutils/Config.in
```kconfig
# Choose binutils version.

choice
	prompt "Binutils Version" if TOOLCHAINOPTS
	default BINUTILS_USE_VERSION_2_28 if !arc
	default BINUTILS_USE_VERSION_2_28_ARC if arc
	help
	  Select the version of binutils you wish to use.

	config BINUTILS_USE_VERSION_2_29
		depends on !arc
		bool "Binutils 2.29"
		select BINUTILS_VERSION_2_29

	config BINUTILS_USE_VERSION_2_28_1
		depends on !arc
		bool "Binutils 2.28.1"
		select BINUTILS_VERSION_2_28_1

	config BINUTILS_USE_VERSION_2_28_ARC
		depends on arc
		bool "ARC binutils 2.28"
		select BINUTILS_VERSION_2_28_ARC

endchoice

config EXTRA_BINUTILS_CONFIG_OPTIONS
	string
	prompt "Additional binutils configure options" if TOOLCHAINOPTS
	default ""
	help
	    Any additional binutils options you may want to include....
```

## toolchain/glibc/Config.in
```kconfig
# Choose glibc version.

choice
	prompt "Glibc Version" if TOOLCHAINOPTS
	default GLIBC_USE_VERSION_2_31
	help
	  Select the version of glibc you wish to use.

	config GLIBC_USE_VERSION_2_28
		bool "glibc 2.28"

	config GLIBC_USE_VERSION_2_29
		bool "glibc 2.29"

	config GLIBC_USE_VERSION_2_31
		bool "glibc 2.31"

endchoice
```
